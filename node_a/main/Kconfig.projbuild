## node_a/main/Kconfig.projbuild
```kconfig
menu "GSA-CAN Node A"

    config GSA_CAN_TX_GPIO
        int "CAN TX GPIO"
        default 15

    config GSA_CAN_RX_GPIO
        int "CAN RX GPIO"
        default 16

endmenu
```

## node_a/sdkconfig.defaults
```kconfig
CONFIG_IDF_TARGET="esp32s3"

# BLE via NimBLE, no WiFi
CONFIG_BT_ENABLED=y
CONFIG_BT_NIMBLE_ENABLED=y
CONFIG_BT_NIMBLE_ATT_PREFERRED_MTU=247
CONFIG_BT_NIMBLE_LOG_LEVEL_WARNING=y

# Console on the S3's native USB
CONFIG_ESP_CONSOLE_USB_SERIAL_JTAG=y
CONFIG_LOG_COLORS=n
```
